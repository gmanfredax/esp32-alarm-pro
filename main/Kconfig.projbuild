## main/Kconfig.projbuild
```kconfig
menu "ESP32 Alarm Cloud Connectivity"

config APP_CLOUD_MQTT_URI
    string "MQTT broker URI (use mqtts:// or wss://)"
    default "mqtts://mqtt.nsalarm.pro:8883"
    help
        URI of the managed MQTT broker reachable from the ESP32. Use the mqtts://
        scheme to enforce TLS. If you are using a WebSocket proxy for outbound
        connections, specify the wss:// endpoint instead.

config APP_CLOUD_DEVICE_ID
    string "Device identifier"
    default ""
    help
        Optional explicit device identifier. If empty the firmware derives the
        identifier from the MAC address and the client ID prefix.

config APP_CLOUD_CLIENT_ID_PREFIX
    string "Client ID prefix"
    default "nsalarmpro-"
    help
        Prefix used to build the MQTT client identifier when APP_CLOUD_DEVICE_ID
        is empty. The final ID is prefix plus the Ethernet MAC address.

config APP_CLOUD_TOPIC_ROOT
    string "MQTT topic root"
    default "alarmpro"
    help
        Root prefix for all MQTT topics used by the application. State topics are
        published under <root>/state/<deviceId>/... and command topics are
        consumed from <root>/cmd/<deviceId>/....

config APP_CLOUD_USERNAME
    string "MQTT username"
    default ""
    help
        Username used by the ESP32 when authenticating to the broker. Leave empty
        when using mutual TLS with client certificates.

config APP_CLOUD_PASSWORD
    string "MQTT password"
    default ""
    help
        Password or token used by the ESP32 when authenticating to the broker.

config APP_CLOUD_KEEPALIVE
    int "MQTT keepalive (seconds)"
    default 60
    range 15 600

config APP_CLOUD_QOS_STATE
    int "QoS for state telemetry"
    default 1
    range 0 2

config APP_CLOUD_QOS_COMMANDS
    int "QoS for command subscriptions"
    default 1
    range 0 2

config APP_CLOUD_WS_PATH
    string "Public MQTT over WebSocket path"
    default "/mqtt"
    help
        Path component to document inside the web UI configuration when the broker
        is exposed via MQTT over WebSocket (WSS). This value does not affect the
        firmware behaviour but is shipped in the configuration bundle that can be
        downloaded from the device.

config APP_CLOUD_TOKEN_ENDPOINT
    string "Token endpoint for UI clients"
    default "https://api.example.com/token"
    help
        Optional HTTPS endpoint exposed by your backend to mint short lived MQTT
        credentials for browser clients. The value is exported inside the web UI
        configuration served from the device.

endmenu

menu "ESP32 Alarm CAN bus"

config APP_CAN_ENABLED
    bool "Enable CAN/TWAI master support"
    default y
    help
        Enable the internal CAN (TWAI) master used to communicate with expansion
        boards. Disable this option when the hardware does not populate the CAN
        transceiver or when the feature is not required.

if APP_CAN_ENABLED

config APP_CAN_TX_GPIO
    int "TWAI TX GPIO"
    default 4
    range 0 39
    help
        GPIO used for the TWAI TX signal. The selected pin must not conflict with
        RMII Ethernet signals or other peripherals already configured in the
        firmware.

config APP_CAN_RX_GPIO
    int "TWAI RX GPIO"
    default 5
    range 0 39
    help
        GPIO used for the TWAI RX signal. The selected pin must support input
        mode and must not overlap with RMII Ethernet signals.

choice APP_CAN_BITRATE
    prompt "TWAI bitrate"
    default APP_CAN_BITRATE_250K
    help
        Select the bitrate used on the CAN/TWAI bus. Make sure that every node
        connected to the bus is configured with the same bitrate.

config APP_CAN_BITRATE_125K
    bool "125 kbit/s"

config APP_CAN_BITRATE_250K
    bool "250 kbit/s"

config APP_CAN_BITRATE_500K
    bool "500 kbit/s"

endchoice

config APP_CAN_NODE_TIMEOUT_MS
    int "Node offline timeout (ms)"
    default 5000
    range 1000 60000
    help
        Time window without heartbeats or PDO frames after which a node is
        considered offline.

config APP_CAN_DEFAULT_NODE_ID
    int "Default node ID for new expansion boards"
    default 1
    range 1 127
    help
        Node ID assigned via Layer Setting Services (LSS) when discovering
        expansion boards that do not yet have a stored CANopen node ID.

config APP_CAN_RX_TASK_STACK
    int "CAN RX task stack size (bytes)"
    default 4096
    range 2048 8192
    help
        Stack size used by the FreeRTOS task responsible for receiving TWAI
        frames.

endif # APP_CAN_ENABLED

endmenu
```

## sdkconfig.defaults
```kconfig
# ==== Flash / Chip ============================================================
CONFIG_ESPTOOLPY_FLASHMODE_DIO=y
CONFIG_ESPTOOLPY_FLASHFREQ_80M=y
CONFIG_ESPTOOLPY_FLASHSIZE_16MB=y
# PSRAM (se non hai PSRAM lascia disabilitato)
# CONFIG_SPIRAM is not set

# ==== Logging / Console =======================================================
CONFIG_LOG_DEFAULT_LEVEL_INFO=y
CONFIG_ESP_CONSOLE_UART_BAUDRATE=115200
CONFIG_NEWLIB_STDIN_LINE_ENDING_CRLF=y
CONFIG_NEWLIB_STDOUT_LINE_ENDING_CRLF=y
CONFIG_ESP_SYSTEM_PANIC_PRINT_REBOOT=y
CONFIG_ESP_CONSOLE_UART_DEFAULT=y

# ==== Partizioni (OTA + SPIFFS custom) =======================================
CONFIG_PARTITION_TABLE_CUSTOM=y
CONFIG_PARTITION_TABLE_FILENAME="partitions.csv"

# ==== SPIFFS filesystem =======================================================
CONFIG_SPIFFS_MAX_PARTITIONS=1
CONFIG_SPIFFS_USE_MAGIC=y
CONFIG_SPIFFS_USE_MAGIC_LENGTH=y
CONFIG_SPIFFS_PAGE_CHECK=y
CONFIG_SPIFFS_GC_MAX_RUNS=64
CONFIG_SPIFFS_CACHE=y

# ==== HTTP server =============================================================
CONFIG_HTTPD_MAX_REQ_HDR_LEN=2048
CONFIG_HTTPD_MAX_URI_LEN=1024
CONFIG_HTTPD_ERR_RESP_NO_DELAY=y
CONFIG_HTTPD_PURGE_BUF_LEN=32

# ==== MQTT ====================================================================
CONFIG_MQTT_PROTOCOL_311=y
CONFIG_MQTT_TRANSPORT_SSL=y
CONFIG_MQTT_BUFFER_SIZE=4096
CONFIG_APP_CLOUD_MQTT_URI="mqtts://broker.example.com:8883"
CONFIG_APP_CLOUD_CLIENT_ID_PREFIX="esp32-alarm-"
CONFIG_APP_CLOUD_TOPIC_ROOT="alarm"
CONFIG_APP_CLOUD_USERNAME=""
CONFIG_APP_CLOUD_PASSWORD=""
CONFIG_APP_CLOUD_KEEPALIVE=60
CONFIG_APP_CLOUD_QOS_STATE=1
CONFIG_APP_CLOUD_QOS_COMMANDS=1
CONFIG_APP_CLOUD_WS_PATH="/mqtt"
CONFIG_APP_CLOUD_TOKEN_ENDPOINT="https://api.example.com/token"

# ==== I²C / SPI ===============================================================
CONFIG_I2C_ISR_IRAM_SAFE=y
CONFIG_SPI_MASTER_ISR_IN_IRAM=y

# ==== Rete ====================================================================
# Ethernet RMII (LAN8720): abilita solo Ethernet; ETH_USE_EMAC non esiste in IDF 5.3
CONFIG_ETH_ENABLED=y
# Se userai anche Wi-Fi abilitalo da menuconfig oppure aggiungi qui le tue opzioni Wi-Fi
CONFIG_ESP_WIFI_ENABLED=n

# ==== Bluetooth ===============================================================
CONFIG_BT_ENABLED=n
CONFIG_BT_NIMBLE_ENABLED=n
CONFIG_BT_BLUEDROID_ENABLED=n

# ==== SNTP / mDNS =============================================================
CONFIG_LWIP_SNTP_MAX_SERVERS=3
CONFIG_LWIP_LOCAL_HOSTNAME="esp32-alarm-pro"
CONFIG_MDNS_MAX_SERVICES=10

# ==== FreeRTOS tuning =========================================================
CONFIG_FREERTOS_HZ=1000
CONFIG_FREERTOS_THREAD_LOCAL_STORAGE_POINTERS=2
CONFIG_FREERTOS_MAX_TASK_NAME_LEN=24
CONFIG_FREERTOS_IDLE_TASK_STACKSIZE=2048
CONFIG_FREERTOS_ISR_STACKSIZE=4096

# ==== OTA updates =============================================================
CONFIG_ESP_HTTPS_OTA_ALLOW_HTTP=y
# (non serve più "OTA_ALLOW_SECURE_HTTP": rimosso)

# ==== OTHER ===================================================================
CONFIG_MBEDTLS_HARDWARE_SHA=y
```
